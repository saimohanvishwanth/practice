VERSION "1.0"
NS_ :

BS_:

BU_: ECU1 ECU2

BO_ 100 ENGINE_STATUS: 8 ECU1
 SG_ EngineSpeed : 0|16@1+ (0.125,0) [0|8000] "RPM" ECU2
 SG_ EngineTemp : 16|8@1+ (1, -40) [-40|215] "C" ECU2

BO_ 200 VEHICLE_SPEED: 8 ECU1
 SG_ VehicleSpeed : 0|16@1+ (0.01,0) [0|250] "km/h" ECU2

BO_ 300 BRAKE_INFO: 8 ECU1
 SG_ BrakePedalStatus : 0|1@1+ (1,0) [0|1] "" ECU2
 SG_ BrakePressure : 8|16@1+ (0.1,0) [0|1000] "bar" ECU2

BO_ 400 STEERING_INFO: 8 ECU1
 SG_ SteeringAngle : 0|16@1- (0.1,0) [-500|500] "deg" ECU2
 SG_ SteeringTorque : 16|16@1- (0.01,0) [-327|327] "Nm" ECU2
